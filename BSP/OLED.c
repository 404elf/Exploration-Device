#include "OLED.h"
#include "string.h"

/* 
 * 简化版英文6x8字体数组 (由于不需要显示大量复杂字体，减小代码体积)
 */
const uint8_t OLED_F6x8[][6] = {
    {0x00, 0x00, 0x00, 0x00, 0x00, 0x00}, // sp
    {0x00, 0x00, 0x00, 0x2f, 0x00, 0x00}, // !
    {0x00, 0x00, 0x07, 0x00, 0x07, 0x00}, // "
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    {0x00, 0x08, 0x04, 0x08, 0x10, 0x08}  // ~
};

/* 微秒延时，使用简易Nop循环替代，STM32F407为168MHz主频，每次循环约耗时一些指令周期 */
static void IIC_Delay(void)
{
    uint32_t t = 100; // 延时一点时间就足够OLED通信，最高只能支持400KHz左右
    while(t--);
}

/* 软件IIC开始 */
static void IIC_Start(void)
{
    OLED_SCL_H();
    OLED_SDA_H();
    IIC_Delay();
    OLED_SDA_L();
    IIC_Delay();
    OLED_SCL_L();
    IIC_Delay();
}

/* 软件IIC停止 */
static void IIC_Stop(void)
{
    OLED_SCL_L();
    OLED_SDA_L();
    IIC_Delay();
    OLED_SCL_H();
    IIC_Delay();
    OLED_SDA_H();
    IIC_Delay();
}

/* 软件IIC发送一个字节 */
static void IIC_SendByte(uint8_t dat)
{
    uint8_t i;
    for(i=0; i<8; i++)
    {
        if(dat & 0x80) OLED_SDA_H();
        else OLED_SDA_L();
        IIC_Delay();
        OLED_SCL_H();
        IIC_Delay();
        OLED_SCL_L();
        dat <<= 1;
    }
    // 等待ACK（简化处理，直接加个周期当忽略应答）
    OLED_SDA_H();
    IIC_Delay();
    OLED_SCL_H();
    IIC_Delay();
    OLED_SCL_L();
    IIC_Delay();
}

/* 写命令 */
static void OLED_WriteCmd(uint8_t cmd)
{
    IIC_Start();
    IIC_SendByte(0x78); // OLED IIC地址(默认0x78/0x7A)
    IIC_SendByte(0x00); // 声明写命令
    IIC_SendByte(cmd);
    IIC_Stop();
}

/* 写数据 */
static void OLED_WriteDat(uint8_t dat)
{
    IIC_Start();
    IIC_SendByte(0x78);
    IIC_SendByte(0x40); // 声明写数据
    IIC_SendByte(dat);
    IIC_Stop();
}

/* 设置光标 */
static void OLED_SetPos(uint8_t x, uint8_t y)
{ 
    OLED_WriteCmd(0xB0 + y);
    OLED_WriteCmd((x & 0x0F) | 0x00);      
    OLED_WriteCmd(((x & 0xF0) >> 4) | 0x10); 
}

/* 清屏 */
void OLED_Clear(void)
{
    uint8_t i, j;
    for(i=0; i<8; i++)  
    {
        OLED_WriteCmd(0xB0 + i); 
        OLED_WriteCmd(0x00);     
        OLED_WriteCmd(0x10);     
        for(j=0; j<128; j++)     
            OLED_WriteDat(0x00);
    }
}

/* 在屏幕上显示字符 */
static void OLED_ShowChar(uint8_t x, uint8_t y, char chr)
{
    uint8_t c = 0, i = 0;
    c = chr - ' '; 
    if(x > 128 - 6) { x = 0; y++; } 
    OLED_SetPos(x, y); 
    for(i = 0; i < 6; i++)
        OLED_WriteDat(OLED_F6x8[c][i]); 
}

/* 在屏幕正中显示字符串 (一行) */
void OLED_ShowCenterString(char *str)
{
    uint8_t len = strlen(str);
    if(len > 21) len = 21; // 取最大字数：128/6=21个
    
    // Y轴放到第3页(近似居中)
    // X轴使其居中：计算起点
    uint8_t start_x = (128 - len * 6) / 2;
    
    OLED_Clear(); // 显示前先清屏
    OLED_SetPos(start_x, 3);
    while(*str != '\0')
    {
        OLED_ShowChar(start_x, 3, *str);
        start_x += 6;
        str++;
    }
}

/* 初始化 */
void OLED_Init(void)
{
    // 延时等待屏幕上电稳定
    HAL_Delay(200); 

    OLED_WriteCmd(0xAE);//关闭显示
    OLED_WriteCmd(0x20);//设置内存寻址模式
    OLED_WriteCmd(0x10);//00,水平寻址; 01,垂直寻址; 10,页寻址(默认); 
    OLED_WriteCmd(0xB0);//为页寻址模式设置页起始地址
    OLED_WriteCmd(0xC8);//设置COM输出扫描方向
    OLED_WriteCmd(0x00);//设置低列地址
    OLED_WriteCmd(0x10);//设置高列地址
    OLED_WriteCmd(0x40);//设置起始行地址
    OLED_WriteCmd(0x81);//设置对比度
    OLED_WriteCmd(0xFF);
    OLED_WriteCmd(0xA1);//设置段重映射
    OLED_WriteCmd(0xA6);//正常显示
    OLED_WriteCmd(0xA8);//设置多路复用率(1 to 64)
    OLED_WriteCmd(0x3F);//设置成64路
    OLED_WriteCmd(0xA4);//正常显示开启
    OLED_WriteCmd(0xD3);//设置显示偏移
    OLED_WriteCmd(0x00);//默认不偏移
    OLED_WriteCmd(0xD5);//设置时钟分频因子
    OLED_WriteCmd(0xF0);//设置分频比
    OLED_WriteCmd(0xD9);//设置预充电周期
    OLED_WriteCmd(0x22);//
    OLED_WriteCmd(0xDA);//设置COM引脚硬件配置
    OLED_WriteCmd(0x12);//
    OLED_WriteCmd(0xDB);//设置VCOMH取消选择级别
    OLED_WriteCmd(0x20);//
    OLED_WriteCmd(0x8D);//电荷泵设置
    OLED_WriteCmd(0x14);//开启电荷泵
    OLED_WriteCmd(0xAF);//开启显示
    
    OLED_Clear();
}






